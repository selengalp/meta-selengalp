## conf/layer.conf
```bitbake
# We have a conf and classes directory, add to BBPATH
BBPATH .= ":${LAYERDIR}"

# We have recipes-* directories, add to BBFILES
BBFILES += "${LAYERDIR}/recipes-*/*/*.bb \
            ${LAYERDIR}/recipes-*/*/*.bbappend"

BBFILE_COLLECTIONS += "meta-selengalp"
BBFILE_PATTERN_meta-selengalp = "^${LAYERDIR}/"
BBFILE_PRIORITY_meta-selengalp = "10"

LAYERDEPENDS_meta-selengalp = "core"
LAYERSERIES_COMPAT_meta-selengalp = "kirkstone"
```
